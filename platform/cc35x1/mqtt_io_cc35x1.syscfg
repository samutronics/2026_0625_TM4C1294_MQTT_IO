/**
 *
 * @cliArgs --board "/ti/boards/LP_EM_CC35X1" --rtos "freertos" --product "simplelink_wifi_sdk@10.10.01.08" --product "TOOLBOX@4.2.4"
 * @versions {"tool":"1.28.0+4696"}
 */

/**
 * Import the modules used in this configuration.
 */
const FreeRTOS              = scripting.addModule("/freertos/FreeRTOS");
const CryptoKeyKeyStore_PSA = scripting.addModule("/ti/drivers/CryptoKeyKeyStore_PSA");
const GPIO                  = scripting.addModule("/ti/drivers/GPIO");
const GPIO1                 = GPIO.addInstance();
const GPIO6                 = GPIO.addInstance();
const GPIO7                 = GPIO.addInstance();
const GPIO8                 = GPIO.addInstance();
const GPIO9                 = GPIO.addInstance();
const GPIO10                = GPIO.addInstance();
const GPIO11                = GPIO.addInstance();
const GPIO12                = GPIO.addInstance();
const GPIO13                = GPIO.addInstance();
const GPIO14                = GPIO.addInstance();
const GPIO15                = GPIO.addInstance();
const Power                 = scripting.addModule("/ti/drivers/Power");
const UART2                 = scripting.addModule("/ti/drivers/UART2");
const UART21                = UART2.addInstance();
const UART22                = UART2.addInstance();
const Settings              = scripting.addModule("/ti/posix/freertos/Settings");

/**
 * Write custom configuration values to the imported modules.
 */
FreeRTOS.useTimeSlicing = true;
FreeRTOS.heapSize       = 0x00057000;

GPIO1.$hardware = system.deviceData.board.components.LED_RED;
GPIO1.$name     = "CONFIG_GPIO_LED_0";

GPIO6.mode            = "Output";
GPIO6.$name           = "CONFIG_GPIO_DIN_CLK";
GPIO6.gpioPin.$assign = "boosterpack.7";

GPIO7.mode            = "Output";
GPIO7.$name           = "CONFIG_GPIO_DIN_CE";
GPIO7.gpioPin.$assign = "boosterpack.18";

GPIO8.$name           = "CONFIG_GPIO_DIN_SOP";
GPIO8.gpioPin.$assign = "boosterpack.14";

GPIO9.mode            = "Output";
GPIO9.$name           = "CONFIG_GPIO_DIN_LD";
GPIO9.gpioPin.$assign = "boosterpack.15";

GPIO10.mode            = "Output";
GPIO10.$name           = "CONFIG_GPIO_REL_CLK";
GPIO10.gpioPin.$assign = "boosterpack.8";

GPIO11.mode            = "Output";
GPIO11.$name           = "CONFIG_GPIO_REL_DIN";
GPIO11.gpioPin.$assign = "boosterpack.13";

GPIO12.$name           = "CONFIG_GPIO_REL_DOUT";
GPIO12.gpioPin.$assign = "boosterpack.11";

GPIO13.mode            = "Output";
GPIO13.$name           = "CONFIG_GPIO_REL_LATCH";
GPIO13.gpioPin.$assign = "boosterpack.12";

GPIO14.mode            = "Output";
GPIO14.$name           = "CONFIG_GPIO_REL_EN";
GPIO14.gpioPin.$assign = "boosterpack.26";

GPIO15.pull            = "Pull Up";
GPIO15.$name           = "CONFIG_GPIO_REL_NFAULT";
GPIO15.gpioPin.$assign = "boosterpack.25";

UART21.$name                     = "CONFIG_UART2_0";
UART21.$hardware                 = system.deviceData.board.components.XDS110UART;
UART21.uart.dmaTxChannel.$assign = "DMA_CH2";
UART21.uart.dmaRxChannel.$assign = "DMA_CH3";

UART22.$name = "CONFIG_UART2_1";

const ActionReq = scripting.addModule("/ti/vendorutils/Action/ActionReq", {}, false);
ActionReq.ota   = true;

/**
 * Pinmux solution for unlocked pins/peripherals. This ensures that minor changes to the automatic solver in a future
 * version of the tool will not impact the pinmux you originally saw.  These lines can be completely deleted in order to
 * re-solve from scratch.
 */
GPIO1.gpioPin.$suggestSolution            = "boosterpack.31";
UART21.uart.$suggestSolution              = "UART1";
UART21.uart.txPin.$suggestSolution        = "GPIO5";
UART21.uart.rxPin.$suggestSolution        = "GPIO6";
UART22.uart.$suggestSolution              = "UART0";
UART22.uart.dmaTxChannel.$suggestSolution = "DMA_CH1";
UART22.uart.dmaRxChannel.$suggestSolution = "DMA_CH0";
UART22.uart.txPin.$suggestSolution        = "boosterpack.4";
UART22.uart.rxPin.$suggestSolution        = "boosterpack.3";
